## drivers/char/tpm/ktpm/Kconfig
```kconfig
config TCG_KTPM
	tristate "Kernel TPM (kTPM) Interface"
	depends on TCG_TPM
	---help---

config TCG_KTPM_TPM2
	bool "kTPM Library Family 1.x"
	depends on TCG_KTPM
	select CRYPTO_SHA1
	---help---

config TCG_KTPM_TPM2
	bool "kTPM Library Family 2.x"
	depends on TCG_KTPM
	select CRYPTO_SHA1
	select CRYPTO_SHA256
	---help---
```
